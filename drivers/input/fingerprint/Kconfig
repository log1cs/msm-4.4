## drivers/input/fingerprint/Kconfig
```kconfig
menu "Nokia Fingerprints"

config SILEAD_FP
	tristate "silead fingerprint drivers"
	default n
	help
	  Say Y here if you want to use silead fingerprint soc drivers.

	  If unsure, say N.

endmenu
```
