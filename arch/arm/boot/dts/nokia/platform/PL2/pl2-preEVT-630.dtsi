/* PL2 preEVT SDM630 */

/* MemMap parts */
#include "../memmap-evb.dtsi"

/* Common DT Info */
#include "../platforminfo/common_info_sdm_v4.dtsi"

/* SYSTEM parts */
#include "../platforminfo/system-preEVT-630.dtsi"

/* External LDO control */
#include "../../misc/external-regulator/fixed-regulator-EVT-v1.dtsi"

/* Keypad parts */
#include "../../misc/keypad.dtsi"

/* PMIC parts */

/* GPIO parts */

/* Peripheral */

/* Charging */
#include "../../charger/charger-evt1.dtsi"

/* Audio */

/* Camera */
#include "../../camera/camera-pl2-evt.dtsi"

/* Haptic */
#include "../../misc/haptics.dtsi"

/* SD */
#include "../../misc/sd-evb.dtsi"

/* Fingerprint */
#include "../../fingerprint/fingerprint_elan.dtsi"
#include "../../fingerprint/fingerprint-gf3208-evt.dtsi"

/* Sensor */
#include "../../misc/hallsensor/hallsensor-fih.dtsi"

/* Touch */
#include "../../display/touch/touch-focaltech8716.dtsi"
#include "../../display/touch/touch-goodix-gt1x-pl2.dtsi"

/* LCM */
#include "../../display/dsi-panel-fih-ft8716-1080p-video-pl2.dtsi"
#include "../../display/dsi-panel-fih-r69338-1080p-video.dtsi"  //ZZDC sunqiupeng add for bringup PL2 2nd panel@20171226

/*Samsung NFC*/
#include "../../misc/nfc/avl8895_i2c.dtsi"
